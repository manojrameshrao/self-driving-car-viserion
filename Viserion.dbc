VERSION ""

NS_ :

BS_:

BU_: DBG MASTER MOTOR SENSORS GEO BT

BO_ 95 HB_SENSORS: 1 SENSORS
 SG_ SENSOR_ALIVE : 0|1@1+ (1,0) [0|0] "HB-S" MASTER,MOTOR,GEO,BT

BO_ 96 HB_MOTORS: 1 MOTOR
 SG_ MOTOR_ALIVE : 0|1@1+ (1,0) [0|0] "HB-M" MASTER,SENSORS,GEO,BT

BO_ 97 HB_GEO: 1 GEO
 SG_ GEO_ALIVE : 0|1@1+ (1,0) [0|0] "HB-G" MASTER,SENSORS,MOTOR,BT

BO_ 98 HB_BT: 1 BT
 SG_ BT_ALIVE : 0|1@1+ (1,0) [0|0] "HB-BT" MASTER,SENSORS,MOTOR,GEO

BO_ 99 HB_MASTER: 1 MASTER
 SG_ MASTER_ALIVE : 0|1@1+ (1,0) [0|0] "HB-MT" BT,SENSORS,MOTOR,GEO

BO_ 500 GET_START_COORDINATES: 1 BT
 SG_ GET_COORDINATES : 0|4@1+ (1,0) [0|0] "" MASTER,GEO

BO_ 503 GET_ROUTE_COORDINATES: 8 BT
 SG_ SET_LATTITUDE : 0|30@1+ (0.000001,-180) [-180|180] "DEGREE" MASTER
 SG_ SET_LONGITUDE : 30|30@1+ (0.000001,-180) [-180|180] "DEGREE" MASTER
